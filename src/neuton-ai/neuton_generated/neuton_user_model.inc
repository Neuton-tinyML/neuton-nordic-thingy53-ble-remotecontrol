/* 2025-01-23T15:39:16Z */

/* ----------------------------------------------------------------------
Copyright (c) 2022-2023 Neuton.AI, Inc.
*
The source code and its binary form are being made available on the following terms:
Redistribution, use, and modification are permitted provided that the following
conditions are met:
*
1. Redistributions of source code and/or its binary form must retain the above copyright notice,
* this list of conditions (and the disclaimer) either in the body of the source code or in
* the documentation and/or other materials provided with the distribution of the binary form, as
applicable.
*
2. The name of the copyright holder may not be used to endorse or promote products derived from this
* source code or its binary form without specific prior written permission of Neuton.AI, Inc.
*
3. Disclaimer. THIS SOURCE CODE AND ITS BINARY FORM ARE PROVIDED BY THE COPYRIGHT HOLDER "AS IS".
* THE COPYRIGHT HOLDER HEREBY DISCLAIMS ANY EXPRESS OR IMPLIED WARRANTIES, INCLUDING,
* BUT NOT LIMITED TO, THE IMPLIED WARRANTIES OF MERCHANTABILITY AND FITNESS FOR A
* PARTICULAR PURPOSE. IN NO EVENT SHALL THE COPYRIGHT HOLDER BE HELD LIABLE
* FOR ANY DIRECT, INDIRECT, INCIDENTAL, SPECIAL, EXEMPLARY, OR CONSEQUENTIAL
* DAMAGES (INCLUDING, BUT NOT LIMITED TO, PROCUREMENT OF SUBSTITUTE GOODS OR
* SERVICES; LOSS OF USE, DATA, OR PROFITS; INFRINGEMENT OF INTELLECTUAL PROPERTY RIGHTS
* OF THIRD PARTIES; OR BUSINESS INTERRUPTION) HOWEVER CAUSED AND ON ANY THEORY OF LIABILITY,
* WHETHER IN CONTRACT, STRICT LIABILITY, OR TORT (INCLUDING NEGLIGENCE OR OTHERWISE) ARISING
* IN ANY WAY OUT OF THE USE OF THIS SOURCE CODE OR ITS BINARY FORM, EVEN IF ADVISED OF THE
* POSSIBILITY OF SUCH DAMAGE.
---------------------------------------------------------------------- */


static const neuton_weight_t MODEL_WEIGHTS[] = { -13990, 18315, 16618, -10172,
     3864, -2483, -12974, 24351, -31544, -3706, 12334, 32767, -12215, -26301,
     32735, 30652, 12315, -8801, 4439, 5666, -11551, -2214, -32766, 16704, 30122,
     5728, -3887, 6168, 14720, 8281, 13142, -28943, -4791, -667, -25726, -24909,
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     -32768, -18772 };

static const neuton_sources_num_t MODEL_LINKS[] = { 0, 1, 4, 16, 23, 27, 30,
     47, 56, 60, 61, 65, 68, 69, 70, 73, 80, 0, 4, 12, 18, 19, 20, 27, 28, 29,
     34, 37, 38, 39, 54, 58, 61, 65, 79, 80, 0, 6, 9, 20, 23, 28, 31, 37, 47,
     53, 57, 61, 63, 70, 80, 0, 0, 5, 6, 10, 12, 15, 16, 17, 18, 20, 28, 31,
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     47, 51, 63, 80 };

static const neuton_weights_num_t MODEL_INTERNAL_LINKS_BOUNDARIES[] = { 0, 18,
     37, 52, 75, 85, 102, 130, 149, 160, 186, 190, 201, 203, 213, 216, 231, 240,
     243, 253, 258, 261, 271, 275, 296, 301, 311, 323, 337, 343, 355, 364, 376,
     387, 403, 411, 425, 439, 446, 464, 475, 488, 503, 515, 524, 542, 551, 560,
     571, 583, 593, 596, 610, 627, 632, 645, 656, 665, 674, 678, 687, 700, 712,
     716, 740 };

static const neuton_weights_num_t MODEL_EXTERNAL_LINKS_BOUNDARIES[] = { 17, 36,
     51, 72, 85, 101, 126, 146, 160, 184, 187, 199, 202, 211, 214, 227, 238,
     241, 249, 256, 259, 269, 274, 294, 299, 307, 320, 332, 340, 351, 362, 372,
     384, 398, 407, 422, 433, 445, 459, 467, 483, 494, 512, 521, 537, 550, 559,
     568, 581, 586, 594, 604, 621, 628, 641, 650, 660, 668, 675, 681, 688, 704,
     713, 726, 741 };

static const neuton_coeff_t MODEL_ACTIVATION_COEFFS[] = { 0, 0, 0, 0, 0, 0, 0,
     0, 0, 0, 17408, 44032, 40939, 0, 40960, 27648, 0, 40960, 64512, 62464, 40957,
     30720, 55296, 0, 0, 0, 0, 0, 0, 55296, 55296, 0, 0, 0, 64512, 0, 0, 64512,
     0, 30720, 64512, 64512, 64512, 0, 0, 0, 64512, 0, 0, 64512, 40959, 0, 0,
     40960, 64512, 64512, 64512, 64512, 40959, 64512, 40959, 0, 40960, 0, 40960 };

static const neuton_u8_t MODEL_ACTIVATION_TYPE_MASK[] = { 0xff, 0xaf, 0xed, 0xff,
     0xff, 0xff, 0xdb, 0xab, 0x00 };

static const neuton_neurons_num_t MODEL_OUTPUT_NEURONS[] = { 64, 12, 14, 58,
     17, 60, 20, 50, 62, 53 };

