## CMakeLists.txt
```
# SPDX-License-Identifier: Apache-2.0

cmake_minimum_required(VERSION 3.20.0)

find_package(Zephyr REQUIRED HINTS $ENV{ZEPHYR_BASE})
project(neuton_ai_thingy53)

set(CMAKE_BUILD_TYPE Debug)

file(GLOB_RECURSE APP_SOURCE_FILES
        "${CMAKE_CURRENT_LIST_DIR}/src/**")

include_directories(${CMAKE_CURRENT_SOURCE_DIR}/src/bsp) 
include_directories(${CMAKE_CURRENT_SOURCE_DIR}/src/neuton-ai/neuton/include)        
include_directories(${CMAKE_CURRENT_SOURCE_DIR}/src/neuton-ai)      

target_sources(app PRIVATE ${APP_SOURCE_FILES})

zephyr_library_include_directories(${ZEPHYR_BASE}/samples/bluetooth)
zephyr_link_libraries(${CMAKE_CURRENT_LIST_DIR}/src/neuton-ai/neuton/lib/libneuton_arm_cortex-m33.a)
```

## Kconfig.sysbuild
```
#
# Copyright (c) 2023 Nordic Semiconductor
#
# SPDX-License-Identifier: LicenseRef-Nordic-5-Clause
#

source "share/sysbuild/Kconfig"

# The Thingy:53 (nRF5340) runs the BLE controller on a separate network core,
# built as the ipc_radio image. Gated on the board: the nRF54L15 is single-core.
if BOARD_THINGY53

config NRF_DEFAULT_IPC_RADIO
	default y

config NETCORE_IPC_RADIO_BT_HCI_IPC
	default y

endif # BOARD_THINGY53
```

## prj.conf
```kconfig
#
# Copyright (c) 2018 Nordic Semiconductor
#
# SPDX-License-Identifier: LicenseRef-Nordic-5-Clause
#
CONFIG_FPU=y

################################################################################
# Sensors — the BMI270 IMU feeds the gesture model on both boards
CONFIG_SENSOR=y
CONFIG_I2C=y
CONFIG_SPI=y
CONFIG_BMI270_TRIGGER_GLOBAL_THREAD=y

################################################################################
# Bluetooth. The application uses its own GATT service (src/ble/gatt), so no
# HID or other profile is required here.
CONFIG_BT=y
CONFIG_BT_PERIPHERAL=y
CONFIG_BT_DEVICE_NAME="Neuton NRF RemoteControl"
CONFIG_BT_DEVICE_APPEARANCE=961
CONFIG_BT_MAX_CONN=2
CONFIG_BT_MAX_PAIRED=0
CONFIG_BT_SMP=n
CONFIG_BT_L2CAP_TX_BUF_COUNT=5
CONFIG_BT_LOG_LEVEL_DBG=n
CONFIG_BT_GATT_UUID16_POOL_SIZE=40
CONFIG_BT_GATT_CHRC_POOL_SIZE=20
CONFIG_BT_CONN_CTX=y
CONFIG_BT_SETTINGS=n

CONFIG_BT_DIS=y
CONFIG_BT_DIS_PNP=y
CONFIG_BT_DIS_MANUF="NordicSemiconductor"
CONFIG_BT_DIS_PNP_VID_SRC=2
CONFIG_BT_DIS_PNP_VID=0x1915
CONFIG_BT_DIS_PNP_PID=0xEEEF
CONFIG_BT_DIS_PNP_VER=0x0100

CONFIG_NCS_SAMPLES_DEFAULTS=y

################################################################################
# Logging and console. The console *backend* is board-specific: Thingy:53 uses
# USB CDC ACM, the nRF54L15 TAG has no USB or exposed UART and uses RTT.
CONFIG_STDOUT_CONSOLE=y
CONFIG_CONSOLE=y
CONFIG_LOG=y
CONFIG_LOG_DEFAULT_LEVEL=1
CONFIG_LOG_MODE_MINIMAL=n

CONFIG_SETTINGS=n
CONFIG_SYSTEM_WORKQUEUE_STACK_SIZE=2048
```

## boards/nrf54l15tag_nrf54l15_cpuapp.conf
```kconfig
#
# Copyright (c) 2025 Nordic Semiconductor ASA
#
# SPDX-License-Identifier: LicenseRef-Nordic-5-Clause
#
# nRF54L15 TAG specific configuration.
#
# Merged on top of prj.conf

################################################################################
# Console and logging over SEGGER RTT — no pins required.
CONFIG_USE_SEGGER_RTT=y
CONFIG_RTT_CONSOLE=y
CONFIG_UART_CONSOLE=n
CONFIG_LOG_BACKEND_RTT=y
CONFIG_LOG_BACKEND_UART=n

################################################################################
# The BMI270 is on spi22 and is already enabled by the board devicetree, so no
# overlay is needed to reach it. Its interrupt line is wired, so the
# data-ready trigger used by bsp_imu works.
```

## boards/thingy53_nrf5340_cpuapp.conf
```kconfig
#
# Copyright (c) 2025 Nordic Semiconductor ASA
#
# SPDX-License-Identifier: LicenseRef-Nordic-5-Clause
#
# Thingy:53 (nRF5340) specific configuration. Merged on top of prj.conf.

# RGB LED is on PWM here, so bsp_led uses its PWM backend.
CONFIG_PWM=y

# Console over USB CDC ACM.
CONFIG_USB_DEVICE_STACK=y
CONFIG_USB_DEVICE_REMOTE_WAKEUP=n
CONFIG_USB_NRFX_WORK_QUEUE_STACK_SIZE=1200
CONFIG_USB_DEVICE_PRODUCT="Thingy:53 Application"
CONFIG_USB_DEVICE_VID=0x1915
CONFIG_USB_DEVICE_PID=0x530C
CONFIG_USB_CDC_ACM=y
CONFIG_UART_LINE_CTRL=y
CONFIG_UART_CONSOLE=y
CONFIG_USB_DEVICE_LOG_LEVEL_ERR=y
CONFIG_USB_DEVICE_LOG_LEVEL_DBG=n

# Flash / storage for the MCUboot DFU flow.
CONFIG_FLASH=y
CONFIG_FLASH_PAGE_LAYOUT=y
CONFIG_FLASH_MAP=y
CONFIG_NVS=y

CONFIG_ADC=y
CONFIG_COUNTER=y
CONFIG_DK_LIBRARY=y
CONFIG_BT_BAS=y
```

## boards/nrf54l15tag_nrf54l15_cpuapp.overlay
```dts
/*
 * Copyright (c) 2025 Nordic Semiconductor ASA
 * SPDX-License-Identifier: Apache-2.0
 *
 * nRF54L15 TAG devicetree additions.
 *
 * The BMI270 IMU on spi22 is already enabled by the board devicetree, so the
 * only thing needed here is a set of generic LED aliases. The board names its
 * RGB channels led1_red/green/blue; bsp_led looks up led-red/green/blue so the
 * BSP does not have to know board-specific node labels.
 */

/ {
	aliases {
		led-red = &led1_red;
		led-green = &led1_green;
		led-blue = &led1_blue;
	};
};
```

## src/main.c
```c
/*
* Copyright (c) 2025 Nordic Semiconductor ASA
* SPDX-License-Identifier: Apache-2.0
*/

#include <soc.h>
#include <stddef.h>
#include <string.h>
#include <assert.h>
#include <zephyr/types.h>

#include <stdio.h>
#include <zephyr/device.h>
#include <zephyr/kernel.h>
#include <zephyr/logging/log.h>
#if defined(CONFIG_USB_DEVICE_STACK)
/* Thingy:53 only — the nRF54L15 has no USB peripheral. */
#include <zephyr/usb/usb_device.h>
#endif

#include <nrf_edgeai/nrf_edgeai.h>
#include <nrf_edgeai_generated/nrf_edgeai_user_model.h>

#include <button/bsp_button.h>
#include <led/bsp_led.h>
#include <sensor/imu/bsp_imu.h>

#include "ble/gatt/ble_gatt.h"
#include "inference_postprocessing.h"
#include "app_version.h"

//////////////////////////////////////////////////////////////////////////////

#define ACCEL_AXIS_NUM (3U)
#define GYRO_AXIS_NUM (3U)
#define NRF_EDGEAI_INPUT_DATA_LEN (ACCEL_AXIS_NUM + GYRO_AXIS_NUM)

#define LED_MAX_BRIGHTNESS (0.2f)
#define LED_BLINK_CHANGE_BRIGHTNESS_STEP (0.005f)

#define SERVICE_THREAD_STACK_SIZE 1024
#define SERVICE_THREAD_PRIORITY   5
#define SERVICE_THREAD_PERIOD_MS  30

#define PRINT_RSSI_INTERVAL_MS 5000

/** Set to 1 to stream raw IMU samples and unfiltered model predictions to the
 * console. For bringing the application up on a new board; leave at 0 normally.
 */
#define APP_DEBUG_IMU_STREAM 0

LOG_MODULE_REGISTER(main);

//////////////////////////////////////////////////////////////////////////////

/**
 * @brief Application remote control mode
 *
 */
typedef enum app_remotectrl_mode_e
{
    /**
     * APP_REMOTECTRL_MODE_PRESENTATION used for slides control:
     * - Swipe Right                       = KEY_ARROW_RIGHT (Next slide)
     * - Swipe Left                        = KEY_ARROW_LEFT  (Previous slide)
     * - Double Tap                        = KEY_F5          (Enter fullscreen mode)
     * - Double Thumb                      = KEY_ESC         (Exit fullscreen mode)
     * - Rotation Clockwise (Right)        = Not used
     * - Rotation Counter Clockwise (Left) = Not used
     *
     */
    APP_REMOTECTRL_MODE_PRESENTATION = 0,

    /**
     * NEUTON_REMOTE_CTRL_MUSIC used for music/media control:
     * - Swipe Right                       = KEY_MEDIA_NEXT_TRACK  (Next track)
     * - Swipe Left                        = KEY_MEDIA_PREV_TRACK  (Previous track)
     * - Double Tap                        = KEY_MEDIA_PLAYPAUSE   (Play/Pause)
     * - Double Thumb                      = KEY_MEDIA_MUTE        (Mute)
     * - Rotation Clockwise (Right)        = KEY_MEDIA_VOLUMEUP    (Volume Up)
     * - Rotation Counter Clockwise (Left) = KEY_MEDIA_VOLUMEDOWN  (Volume Down)
     */
    APP_REMOTECTRL_MODE_MUSIC
} app_remotectrl_mode_t;

typedef int (*led_set_func_t)(float brightness);

//////////////////////////////////////////////////////////////////////////////

static void board_support_init_(void);
static void imu_data_ready_cb_(void);
static void ble_connection_cb_(bool connected);
static void button_click_handler_(bool pressed);
static void ble_send_recognized_class_(const class_label_t class_label, size_t probability_pct);
static void model_prediction_handler_(const class_label_t class_label, 
                                        const float probability,
                                        const char* class_name,
                                        const bool is_raw);

static void service_thread_fn_(void *p1, void *p2, void *p3);

//////////////////////////////////////////////////////////////////////////////

static bool ble_connected_ = false;
static struct k_sem imu_data_ready_sem_;
static nrf_edgeai_t* p_model_ = NULL;

//////////////////////////////////////////////////////////////////////////////

K_THREAD_DEFINE(led_thread_id, SERVICE_THREAD_STACK_SIZE,
                service_thread_fn_, NULL, NULL, NULL,
                SERVICE_THREAD_PRIORITY, 0, 0);

//////////////////////////////////////////////////////////////////////////////

int main(void)
{
    /** Initialize Board Support Package */
    board_support_init_();

    /** Get generated user model runtime context */
    p_model_ = nrf_edgeai_user_model();
    assert(p_model_ != NULL);
    assert(nrf_edgeai_is_runtime_compatible(p_model_));

    /** Initialize nRF Edge AI library */
    nrf_edgeai_err_t res = nrf_edgeai_init(p_model_);
    assert(res == NRF_EDGEAI_ERR_SUCCESS);
    
    nrf_edgeai_rt_version_t version = nrf_edgeai_runtime_version();

    printk("nRF Edge AI Gestures Recognition Demo: \r\n");
    printk("\t Application version: %d.%d.%d\r\n", APP_VERSION_MAJOR, APP_VERSION_MINOR, APP_VERSION_PATCH);
    printk("\t nRF Edge AI Runtime Version: %d.%d.%d\r\n", version.field.major, version.field.minor, version.field.patch);
    printk("\t nRF Edge AI Lab Solution id: %s\r\n", nrf_edgeai_solution_id_str(p_model_));

    bsp_imu_data_t imu_data = {0};
    int16_t input_data[NRF_EDGEAI_INPUT_DATA_LEN];

    for (;;)
    {
        /** Wait for the semaphore to be released by IMU data ready interrupt */
        k_sem_take(&imu_data_ready_sem_, K_FOREVER);

        /** Read IMU sensor data sample */
        if (bsp_imu_read(&imu_data) != BSP_STATUS_SUCCESS)
            continue;

        input_data[0] = imu_data.accel[0].raw;
        input_data[1] = imu_data.accel[1].raw;
        input_data[2] = imu_data.accel[2].raw;
        input_data[3] = imu_data.gyro[0].raw;
        input_data[4] = imu_data.gyro[1].raw;
        input_data[5] = imu_data.gyro[2].raw;

#if APP_DEBUG_IMU_STREAM
        /** Board bring-up aid: print a sample twice per second. At rest one
         * accel axis should read close to +/-9800 (milli-m/s^2) and the others
         * near zero — that identifies the sensor's orientation on this board.
         */
        static uint32_t sample_count_ = 0;
        if ((sample_count_++ % 50) == 0)
        {
            printk("IMU a=[%6d %6d %6d] g=[%6d %6d %6d]\r\n",
                   input_data[0], input_data[1], input_data[2],
                   input_data[3], input_data[4], input_data[5]);
        }
#endif
        /** Feed and prepare raw sensor inputs for the model inference */
        res = nrf_edgeai_feed_inputs(p_model_, input_data, NRF_EDGEAI_INPUT_DATA_LEN);

        /** Check if input data window is ready for inference */
        if (res == NRF_EDGEAI_ERR_SUCCESS)
        {
            /** Run Neuton model inference */
            res = nrf_edgeai_run_inference(p_model_);

            /** Handle Neuton inference results if the prediction was
             * successful */
            if (res == NRF_EDGEAI_ERR_SUCCESS)
            {
                /** Predicted class */
                uint16_t predicted_target = p_model_->decoded_output.classif.predicted_class;
                /** Probabilities pointer depend on model output quantization setting */
                const flt32_t* p_probabilities = p_model_->decoded_output.classif.probabilities.p_f32;

                /** With the debug stream on, skip postprocessing so every
                 * inference is reported as "RAW Prediction" — postprocessing
                 * otherwise hides classes that fail the repeat/probability
                 * thresholds, which is exactly what needs inspecting during
                 * board bring-up. */
                bool do_postprocessing = !APP_DEBUG_IMU_STREAM;
                inference_postprocess(predicted_target,
                                      p_probabilities[predicted_target],
                                      do_postprocessing,
                                      model_prediction_handler_);
            }
        }
    }

    return 0;
}

//////////////////////////////////////////////////////////////////////////////

static void board_support_init_(void)
{
    int ret;

    /** Initialize LEDs */
    ret = bsp_led_init();
    if (ret != 0)
    {
        printk("Failed to initialize LEDs module, error = %d\n", ret);
    }

    /** Initialize user button */
    ret = bsp_button_init();
    if (ret != 0)
    {
        printk("Failed to initialize user button, error = %d\n", ret);
    }
    bsp_button_reg_click_handler(button_click_handler_);

    /** Initialize IMU sensor  */
    bsp_imu_config_t imu_config = 
    {
        .accel_fs_g = BSP_IMU_ACCEL_SCALE_4G,
        .gyro_fs_dps = BSP_IMU_ACCEL_SCALE_1000DPS,
        .data_rate_hz = 100
    };

    bsp_status_t status = bsp_imu_init(&imu_config, imu_data_ready_cb_);
    if (status != BSP_STATUS_SUCCESS)
    {
        printk("Failed to initialize IMU sensor, error = %d\n", (int)status);
    }
    k_sem_init(&imu_data_ready_sem_, 0, 1); // Initial count 0, max count 1

    /** Initialize BLE HID profile */
    ret = ble_gatt_init(ble_connection_cb_, NULL);
    if (ret != 0)
    {
        printk("Failed to initialize BLE HID service\n");
    }
}

//////////////////////////////////////////////////////////////////////////////

static void button_click_handler_(bool pressed)
{
    if (pressed)
    {
        bsp_led_off();
    }
}

//////////////////////////////////////////////////////////////////////////////

static void ble_connection_cb_(bool connected)
{
    ble_connected_ = connected;
    bsp_led_off();
}

//////////////////////////////////////////////////////////////////////////////

static void imu_data_ready_cb_(void)
{
    k_sem_give(&imu_data_ready_sem_); // Release the semaphore
}

//////////////////////////////////////////////////////////////////////////////

static void model_prediction_handler_(const class_label_t class_label, 
                                        const float probability,
                                        const char* class_name,
                                        const bool is_raw)
{
    static const uint32_t PREDICTION_TIMEOUT_MS = 800U;
    size_t probability_pct = (size_t)(100 * probability);

    if (is_raw)
    {
        printk("RAW Prediction %s %d %%\r\n", class_name, probability_pct);
    }
    else if (class_label != CLASS_LABEL_UNKNOWN && class_label != CLASS_LABEL_IDLE)
    {
        static uint32_t last_prediction_time_ms_ = 0;
        uint32_t current_time_ms = k_uptime_get();

        /** For classes CLASS_LABEL_ROTATION_RIGHT & CLASS_LABEL_ROTATION_LEFT there is no timeout,
         * since the movements must be repetitive in time
         */
        if ((class_label == CLASS_LABEL_ROTATION_RIGHT) ||
            (class_label == CLASS_LABEL_ROTATION_LEFT) ||
            (current_time_ms - last_prediction_time_ms_) > PREDICTION_TIMEOUT_MS)
        {
            last_prediction_time_ms_ = current_time_ms;

            printk("Predicted class: %s, with probability %d %%\r\n", class_name, probability_pct);

            ble_send_recognized_class_(class_label, probability_pct);
        }
    }
}

//////////////////////////////////////////////////////////////////////////////

static void ble_send_recognized_class_(const class_label_t class_label, size_t probability_pct)
{
    static char send_buff[15] = {0};
    memset(send_buff, 0, sizeof(send_buff));

    snprintf(send_buff, sizeof(send_buff), "%d,%d", (int)class_label, (int)probability_pct);

    ble_gatt_send_raw_data((const uint8_t*)&send_buff, strlen(send_buff));
}

//////////////////////////////////////////////////////////////////////////////

static void service_thread_fn_(void *p1, void *p2, void *p3)
{
    static bool rising = true;
    static float brightness = 0;

    while (1)
    {
        if (ble_connected_)
        {
            bsp_led_set_green(brightness);
        }
        else
        {
            bsp_led_set_red(brightness);
        }

        if (rising)
        {
            brightness += LED_BLINK_CHANGE_BRIGHTNESS_STEP;
            if (brightness >= LED_MAX_BRIGHTNESS)
                rising = false;
        }
        else
        {
            brightness -= LED_BLINK_CHANGE_BRIGHTNESS_STEP;
            if (brightness <= 0)
                rising = true;
        }

        k_msleep(SERVICE_THREAD_PERIOD_MS);
    }
}
```

## src/app_version.h
```c
/* 2023-06-09T11:22:25Z */

/* ----------------------------------------------------------------------
Copyright (c) 2022-2024 Neuton.AI, Inc.
*
The source code and its binary form are being made available on the following terms:
Redistribution, use, and modification are permitted provided that the following
conditions are met:
*
1. Redistributions of source code and/or its binary form must retain the above copyright notice,
* this list of conditions (and the disclaimer) either in the body of the source code or in
* the documentation and/or other materials provided with the distribution of the binary form, as
applicable.
*
2. The name of the copyright holder may not be used to endorse or promote products derived from this
* source code or its binary form without specific prior written permission of Neuton.AI, Inc.
*
3. Disclaimer. THIS SOURCE CODE AND ITS BINARY FORM ARE PROVIDED BY THE COPYRIGHT HOLDER "AS IS".
* THE COPYRIGHT HOLDER HEREBY DISCLAIMS ANY EXPRESS OR IMPLIED WARRANTIES, INCLUDING,
* BUT NOT LIMITED TO, THE IMPLIED WARRANTIES OF MERCHANTABILITY AND FITNESS FOR A
* PARTICULAR PURPOSE. IN NO EVENT SHALL THE COPYRIGHT HOLDER BE HELD LIABLE
* FOR ANY DIRECT, INDIRECT, INCIDENTAL, SPECIAL, EXEMPLARY, OR CONSEQUENTIAL
* DAMAGES (INCLUDING, BUT NOT LIMITED TO, PROCUREMENT OF SUBSTITUTE GOODS OR
* SERVICES; LOSS OF USE, DATA, OR PROFITS; INFRINGEMENT OF INTELLECTUAL PROPERTY RIGHTS
* OF THIRD PARTIES; OR BUSINESS INTERRUPTION) HOWEVER CAUSED AND ON ANY THEORY OF LIABILITY,
* WHETHER IN CONTRACT, STRICT LIABILITY, OR TORT (INCLUDING NEGLIGENCE OR OTHERWISE) ARISING
* IN ANY WAY OUT OF THE USE OF THIS SOURCE CODE OR ITS BINARY FORM, EVEN IF ADVISED OF THE
* POSSIBILITY OF SUCH DAMAGE.
---------------------------------------------------------------------- */
#ifndef __APPLICATION_VERSION_H__
#define __APPLICATION_VERSION_H__


#define APP_VERSION_MAJOR    2
#define APP_VERSION_MINOR    1
#define APP_VERSION_PATCH    0


#endif /* __APPLICATION_VERSION_H__ */
```

## src/inference_postprocessing.c
```c
// ///////////////////////// Package Header Files ////////////////////////////
#include "inference_postprocessing.h"

// ////////////////////// Standard C++ Header Files //////////////////////////
// /////////////////////// Standard C Header Files ///////////////////////////
#include <string.h>

///
#define PREVIOUS_PREDICTION_NUM                 (3)
///

//////////////////////////////////////////////////////////////////////////////

typedef struct prediction_ctx_s
{
    /** Prediction target */
    uint16_t target;

    /** Prediction probability */
    float probability;
} prediction_ctx_t;

typedef struct prediction_tracer_s
{
    /** Current prediction index */
    int index;

    /** Current prediction target */
    uint16_t target;

    /** Previous predictions context */
    prediction_ctx_t prev[PREVIOUS_PREDICTION_NUM];
} prediction_tracer_t;

/**
 * @brief Class prediction conditions for postprocessing
 * 
 */
typedef struct class_prediction_condition_s
{
    /** Minimum number of repetitions of a class for prediction */
    uint16_t min_repeat_count;

    /** Minimum probability threshold for prediction */
    float probability_threshold;
} class_prediction_condition_t;

//////////////////////////////////////////////////////////////////////////////

static const class_prediction_condition_t* get_class_condition_(uint8_t predicted_target);
static const char* get_name_by_target_(uint8_t predicted_target);

//////////////////////////////////////////////////////////////////////////////

void inference_postprocess(const uint16_t predicted_target,
                            const float prob,
                            const bool do_postprocessing,
                            inference_postprocess_cb_t callback)
{
    uint16_t target = predicted_target;
    float probability = prob;
    
    static prediction_tracer_t tracer_ = {0U};

    if (do_postprocessing) {

        if ((target == CLASS_LABEL_UNKNOWN) || (target == CLASS_LABEL_IDLE)) {
            /** Reset tracer for UNKNOWN and IDLE classes */
            tracer_.index = 0;
            tracer_.target = target;
        } else {
            if (tracer_.index >= PREVIOUS_PREDICTION_NUM)
                tracer_.index = 0;

            /** Reset tracer if predicted class is not the same as previous */
            if (tracer_.target != target) {
                tracer_.index = 0;
                tracer_.target = target;
            }

            tracer_.prev[tracer_.index].probability = probability;
            tracer_.index++;

            const class_prediction_condition_t* class_condition = get_class_condition_(target);
            if (class_condition == NULL) {
                return;
            }

            /** Сlass is labled as CLASS_LABEL_UNKNOWN if the number of repetitions does not exceed the threshold */
            if (tracer_.index >= class_condition->min_repeat_count) {
                /** Calculate average probability for last N predictions of the same class */
                float average_prob = 0.0f;

                for (int i = 0; i < tracer_.index; ++i)
                    average_prob += tracer_.prev[i].probability;

                average_prob = average_prob / tracer_.index;

                /** If average probability is less the class probability threshold,
                 * the class is labled as CLASS_LABEL_UNKNOWN */
                if (average_prob < class_condition->probability_threshold)
                    target = CLASS_LABEL_UNKNOWN;
                else
                    probability = average_prob;

                /** Reset tracer index for non-repetative classes */
                if ((target != CLASS_LABEL_ROTATION_RIGHT) || (target != CLASS_LABEL_ROTATION_LEFT))
                    tracer_.index = 0;
            } else {
                target = CLASS_LABEL_UNKNOWN;
            }
        }
    }

    /** Provide result to user callback */
    if (callback)
        callback(target, probability, get_name_by_target_(target), !do_postprocessing);
}

//////////////////////////////////////////////////////////////////////////////

static const char* get_name_by_target_(uint8_t predicted_target)
{

    static const char* LABEL_VS_NAME[] = 
    {
        [CLASS_LABEL_IDLE]           = "IDLE",
        [CLASS_LABEL_UNKNOWN]        = "UNKNOWN",
        [CLASS_LABEL_SWIPE_LEFT]     = "SWIPE LEFT",
        [CLASS_LABEL_SWIPE_RIGHT]    = "SWIPE RIGHT",
        [CLASS_LABEL_DOUBLE_SHAKE]   = "DOUBLE SHAKE",
        [CLASS_LABEL_DOUBLE_THUMB]   = "DOUBLE THUMB",
        [CLASS_LABEL_ROTATION_RIGHT] = "ROTATION RIGHT",
        [CLASS_LABEL_ROTATION_LEFT]  = "ROTATION LEFT"
    };

    static const uint8_t LABELS_CNT = sizeof(LABEL_VS_NAME) / sizeof(LABEL_VS_NAME[0]);

    return (predicted_target < LABELS_CNT) ? LABEL_VS_NAME[predicted_target] : NULL;
}

//////////////////////////////////////////////////////////////////////////////

static const class_prediction_condition_t* get_class_condition_(uint8_t predicted_target)
{
    static const class_prediction_condition_t LABEL_VS_CONFIG[] = 
    {
        [CLASS_LABEL_IDLE]           = {0, 0.0},
        [CLASS_LABEL_UNKNOWN]        = {0, 0.0},
        [CLASS_LABEL_SWIPE_LEFT]     = {2, 0.8},
        [CLASS_LABEL_SWIPE_RIGHT]    = {2, 0.8},
        [CLASS_LABEL_DOUBLE_SHAKE]   = {2, 0.7},
        [CLASS_LABEL_DOUBLE_THUMB]   = {2, 0.7},
        [CLASS_LABEL_ROTATION_RIGHT] = {2, 0.5},
        [CLASS_LABEL_ROTATION_LEFT]  = {2, 0.7},
    };

    static const uint8_t LABELS_CNT = sizeof(LABEL_VS_CONFIG) / sizeof(LABEL_VS_CONFIG[0]);

    return (predicted_target < LABELS_CNT) ? &LABEL_VS_CONFIG[predicted_target] : NULL;
}
```

## src/inference_postprocessing.h
```c
/* 2023-06-09T11:22:25Z */

/* ----------------------------------------------------------------------
Copyright (c) 2022-2024 Neuton.AI, Inc.
*
The source code and its binary form are being made available on the following terms:
Redistribution, use, and modification are permitted provided that the following
conditions are met:
*
1. Redistributions of source code and/or its binary form must retain the above copyright notice,
* this list of conditions (and the disclaimer) either in the body of the source code or in
* the documentation and/or other materials provided with the distribution of the binary form, as
applicable.
*
2. The name of the copyright holder may not be used to endorse or promote products derived from this
* source code or its binary form without specific prior written permission of Neuton.AI, Inc.
*
3. Disclaimer. THIS SOURCE CODE AND ITS BINARY FORM ARE PROVIDED BY THE COPYRIGHT HOLDER "AS IS".
* THE COPYRIGHT HOLDER HEREBY DISCLAIMS ANY EXPRESS OR IMPLIED WARRANTIES, INCLUDING,
* BUT NOT LIMITED TO, THE IMPLIED WARRANTIES OF MERCHANTABILITY AND FITNESS FOR A
* PARTICULAR PURPOSE. IN NO EVENT SHALL THE COPYRIGHT HOLDER BE HELD LIABLE
* FOR ANY DIRECT, INDIRECT, INCIDENTAL, SPECIAL, EXEMPLARY, OR CONSEQUENTIAL
* DAMAGES (INCLUDING, BUT NOT LIMITED TO, PROCUREMENT OF SUBSTITUTE GOODS OR
* SERVICES; LOSS OF USE, DATA, OR PROFITS; INFRINGEMENT OF INTELLECTUAL PROPERTY RIGHTS
* OF THIRD PARTIES; OR BUSINESS INTERRUPTION) HOWEVER CAUSED AND ON ANY THEORY OF LIABILITY,
* WHETHER IN CONTRACT, STRICT LIABILITY, OR TORT (INCLUDING NEGLIGENCE OR OTHERWISE) ARISING
* IN ANY WAY OUT OF THE USE OF THIS SOURCE CODE OR ITS BINARY FORM, EVEN IF ADVISED OF THE
* POSSIBILITY OF SUCH DAMAGE.
---------------------------------------------------------------------- */
#ifndef INFERENCE_POSTPROCESSING_H__
#define INFERENCE_POSTPROCESSING_H__

#include <stdint.h>
#include <stdbool.h>

typedef enum
{
    CLASS_LABEL_UNKNOWN = 0,            ///< CLASS_LABEL_UNKNOWN
    CLASS_LABEL_SWIPE_UP = 1,           ///< CLASS_LABEL_SWIPE_UP
    CLASS_LABEL_SWIPE_DOWN = 2,         ///< CLASS_LABEL_SWIPE_DOWN
    CLASS_LABEL_SWIPE_LEFT = 3,         ///< CLASS_LABEL_SWIPE_LEFT
    CLASS_LABEL_SWIPE_RIGHT = 4,        ///< CLASS_LABEL_SWIPE_RIGHT
    CLASS_LABEL_DOUBLE_THUMB = 5,       ///< CLASS_LABEL_DOUBLE_THUMB
    CLASS_LABEL_DOUBLE_SHAKE = 6,       ///< CLASS_LABEL_DOUBLE_SHAKE
    CLASS_LABEL_ROTATION_RIGHT = 7,     ///< CLASS_LABEL_ROTATION_RIGHT
    CLASS_LABEL_ROTATION_LEFT = 8,      ///< CLASS_LABEL_ROTATION_LEFT
    CLASS_LABEL_IDLE = 9                ///< CLASS_LABEL_IDLE
} class_label_t;

/**
 * @brief Inference Result (prediction) postprocessing callback
 * 
 * @param[in] class_label   Label of the predicted class @ref class_label_t
 * @param[in] probability   Probability of the predicted class   
 * @param[in] class_name    Name of predicted class, null-terminated string
 * @param[in] is_raw        If true the postprocessing logic was not applied to this prediction
 * 
 */
typedef void (*inference_postprocess_cb_t)(const class_label_t class_label, 
                                            const float probability,
                                            const char* class_name,
                                            const bool is_raw);

/**
 * @brief Postprocess the Neuton library RAW inference output
 * 
 * @param[in] predicted_target  Predicted target(class)
 * @param[in] probability       Predicted probability of the target
 * @param[in] do_postprocessing If false, no postprocessing is applied and the raw prediction goes to the user callback unchanged
 * @param[in] callback          Inference Result (prediction) ready user callback, @ref inference_postprocess_cb_t 
 */
void inference_postprocess(const uint16_t predicted_target,
                            const float probability,
                            const bool do_postprocessing,
                            inference_postprocess_cb_t callback);



#endif /* INFERENCE_POSTPROCESSING_H__ */
```
